## build/Kconfig/arch/Kconfig
```kconfig
# Load Zephyr Arch Kconfig descriptions.
osource "/home/lpp/challenge/challenge-zephyr-hello/zephyr/arch/x86/Kconfig"
osource "/home/lpp/challenge/challenge-zephyr-hello/zephyr/arch/xtensa/Kconfig"
osource "/home/lpp/challenge/challenge-zephyr-hello/zephyr/arch/sparc/Kconfig"
osource "/home/lpp/challenge/challenge-zephyr-hello/zephyr/arch/riscv/Kconfig"
osource "/home/lpp/challenge/challenge-zephyr-hello/zephyr/arch/posix/Kconfig"
osource "/home/lpp/challenge/challenge-zephyr-hello/zephyr/arch/nios2/Kconfig"
osource "/home/lpp/challenge/challenge-zephyr-hello/zephyr/arch/mips/Kconfig"
osource "/home/lpp/challenge/challenge-zephyr-hello/zephyr/arch/arm64/Kconfig"
osource "/home/lpp/challenge/challenge-zephyr-hello/zephyr/arch/arm/Kconfig"
osource "/home/lpp/challenge/challenge-zephyr-hello/zephyr/arch/arc/Kconfig"
```

## build/Kconfig/boards/Kconfig.defconfig
```kconfig
# Load Zephyr board defconfig descriptions.
osource "/home/lpp/challenge/challenge-zephyr-hello/zephyr/boards/qemu/x86/Kconfig.defconfig"
```

## build/Kconfig/boards/Kconfig.sysbuild
```kconfig
# Load Sysbuild board Kconfig descriptions.
osource "/home/lpp/challenge/challenge-zephyr-hello/zephyr/boards/qemu/x86/Kconfig.sysbuild"
```

## build/Kconfig/soc/Kconfig
```kconfig
# Load Zephyr SoC Kconfig descriptions.
osource "/home/lpp/challenge/challenge-zephyr-hello/zephyr/soc/xlnx/zynqmp/Kconfig"
osource "/home/lpp/challenge/challenge-zephyr-hello/zephyr/soc/xlnx/zynq7000/Kconfig"
osource "/home/lpp/challenge/challenge-zephyr-hello/zephyr/soc/xlnx/versalnet/Kconfig"
osource "/home/lpp/challenge/challenge-zephyr-hello/zephyr/soc/xen/Kconfig"
osource "/home/lpp/challenge/challenge-zephyr-hello/zephyr/soc/wch/ch32v/Kconfig"
osource "/home/lpp/challenge/challenge-zephyr-hello/zephyr/soc/ti/simplelink/Kconfig"
osource "/home/lpp/challenge/challenge-zephyr-hello/zephyr/soc/ti/lm3s6965/Kconfig"
osource "/home/lpp/challenge/challenge-zephyr-hello/zephyr/soc/ti/k3/Kconfig"
osource "/home/lpp/challenge/challenge-zephyr-hello/zephyr/soc/telink/tlsr/Kconfig"
osource "/home/lpp/challenge/challenge-zephyr-hello/zephyr/soc/starfive/jh71xx/Kconfig"
osource "/home/lpp/challenge/challenge-zephyr-hello/zephyr/soc/st/stm32/Kconfig"
osource "/home/lpp/challenge/challenge-zephyr-hello/zephyr/soc/snps/qemu_arc/Kconfig"
osource "/home/lpp/challenge/challenge-zephyr-hello/zephyr/soc/snps/nsim/arc_v/Kconfig"
osource "/home/lpp/challenge/challenge-zephyr-hello/zephyr/soc/snps/nsim/arc_classic/Kconfig"
osource "/home/lpp/challenge/challenge-zephyr-hello/zephyr/soc/snps/hsdk4xd/Kconfig"
osource "/home/lpp/challenge/challenge-zephyr-hello/zephyr/soc/snps/hsdk/Kconfig"
osource "/home/lpp/challenge/challenge-zephyr-hello/zephyr/soc/snps/emsk/Kconfig"
osource "/home/lpp/challenge/challenge-zephyr-hello/zephyr/soc/snps/emsdp/Kconfig"
osource "/home/lpp/challenge/challenge-zephyr-hello/zephyr/soc/snps/arc_iot/Kconfig"
osource "/home/lpp/challenge/challenge-zephyr-hello/zephyr/soc/silabs/Kconfig"
osource "/home/lpp/challenge/challenge-zephyr-hello/zephyr/soc/sifive/sifive_freedom/Kconfig"
osource "/home/lpp/challenge/challenge-zephyr-hello/zephyr/soc/sensry/Kconfig"
osource "/home/lpp/challenge/challenge-zephyr-hello/zephyr/soc/rockchip/Kconfig"
osource "/home/lpp/challenge/challenge-zephyr-hello/zephyr/soc/renode/riscv_virtual/Kconfig"
osource "/home/lpp/challenge/challenge-zephyr-hello/zephyr/soc/renode/cortex_r8_virtual/Kconfig"
osource "/home/lpp/challenge/challenge-zephyr-hello/zephyr/soc/renesas/smartbond/Kconfig"
osource "/home/lpp/challenge/challenge-zephyr-hello/zephyr/soc/renesas/rzt2m/Kconfig"
osource "/home/lpp/challenge/challenge-zephyr-hello/zephyr/soc/renesas/rz/Kconfig"
osource "/home/lpp/challenge/challenge-zephyr-hello/zephyr/soc/renesas/rcar/Kconfig"
osource "/home/lpp/challenge/challenge-zephyr-hello/zephyr/soc/renesas/ra/Kconfig"
osource "/home/lpp/challenge/challenge-zephyr-hello/zephyr/soc/realtek/ec/Kconfig"
osource "/home/lpp/challenge/challenge-zephyr-hello/zephyr/soc/raspberrypi/rpi_pico/Kconfig"
osource "/home/lpp/challenge/challenge-zephyr-hello/zephyr/soc/quicklogic/eos_s3/Kconfig"
osource "/home/lpp/challenge/challenge-zephyr-hello/zephyr/soc/qemu/virt_riscv/Kconfig"
osource "/home/lpp/challenge/challenge-zephyr-hello/zephyr/soc/qemu/malta/Kconfig"
osource "/home/lpp/challenge/challenge-zephyr-hello/zephyr/soc/openisa/rv32m1/Kconfig"
osource "/home/lpp/challenge/challenge-zephyr-hello/zephyr/soc/oct/osd32mp15x/Kconfig"
osource "/home/lpp/challenge/challenge-zephyr-hello/zephyr/soc/nxp/s32/Kconfig"
osource "/home/lpp/challenge/challenge-zephyr-hello/zephyr/soc/nxp/rw/Kconfig"
osource "/home/lpp/challenge/challenge-zephyr-hello/zephyr/soc/nxp/mcx/Kconfig"
osource "/home/lpp/challenge/challenge-zephyr-hello/zephyr/soc/nxp/lpc/Kconfig"
osource "/home/lpp/challenge/challenge-zephyr-hello/zephyr/soc/nxp/layerscape/Kconfig"
osource "/home/lpp/challenge/challenge-zephyr-hello/zephyr/soc/nxp/kinetis/Kconfig"
osource "/home/lpp/challenge/challenge-zephyr-hello/zephyr/soc/nxp/imxrt/Kconfig"
osource "/home/lpp/challenge/challenge-zephyr-hello/zephyr/soc/nxp/imx/Kconfig"
osource "/home/lpp/challenge/challenge-zephyr-hello/zephyr/soc/nuvoton/numicro/Kconfig"
osource "/home/lpp/challenge/challenge-zephyr-hello/zephyr/soc/nuvoton/numaker/Kconfig"
osource "/home/lpp/challenge/challenge-zephyr-hello/zephyr/soc/nuvoton/npcx/Kconfig"
osource "/home/lpp/challenge/challenge-zephyr-hello/zephyr/soc/nuvoton/npcm/Kconfig"
osource "/home/lpp/challenge/challenge-zephyr-hello/zephyr/soc/nordic/Kconfig"
osource "/home/lpp/challenge/challenge-zephyr-hello/zephyr/soc/neorv32/Kconfig"
osource "/home/lpp/challenge/challenge-zephyr-hello/zephyr/soc/native/inf_clock/Kconfig"
osource "/home/lpp/challenge/challenge-zephyr-hello/zephyr/soc/microchip/miv/Kconfig"
osource "/home/lpp/challenge/challenge-zephyr-hello/zephyr/soc/microchip/mec/Kconfig"
osource "/home/lpp/challenge/challenge-zephyr-hello/zephyr/soc/mediatek/mt8xxx/Kconfig"
osource "/home/lpp/challenge/challenge-zephyr-hello/zephyr/soc/lowrisc/opentitan/Kconfig"
osource "/home/lpp/challenge/challenge-zephyr-hello/zephyr/soc/litex/litex_vexriscv/Kconfig"
osource "/home/lpp/challenge/challenge-zephyr-hello/zephyr/soc/ite/ec/Kconfig"
osource "/home/lpp/challenge/challenge-zephyr-hello/zephyr/soc/intel/raptor_lake/Kconfig"
osource "/home/lpp/challenge/challenge-zephyr-hello/zephyr/soc/intel/lakemont/Kconfig"
osource "/home/lpp/challenge/challenge-zephyr-hello/zephyr/soc/intel/intel_socfpga_std/Kconfig"
osource "/home/lpp/challenge/challenge-zephyr-hello/zephyr/soc/intel/intel_socfpga/Kconfig"
osource "/home/lpp/challenge/challenge-zephyr-hello/zephyr/soc/intel/intel_niosv/Kconfig"
osource "/home/lpp/challenge/challenge-zephyr-hello/zephyr/soc/intel/intel_ish/Kconfig"
osource "/home/lpp/challenge/challenge-zephyr-hello/zephyr/soc/intel/intel_adsp/Kconfig"
osource "/home/lpp/challenge/challenge-zephyr-hello/zephyr/soc/intel/elkhart_lake/Kconfig"
osource "/home/lpp/challenge/challenge-zephyr-hello/zephyr/soc/intel/atom/Kconfig"
osource "/home/lpp/challenge/challenge-zephyr-hello/zephyr/soc/intel/apollo_lake/Kconfig"
osource "/home/lpp/challenge/challenge-zephyr-hello/zephyr/soc/intel/alder_lake/Kconfig"
osource "/home/lpp/challenge/challenge-zephyr-hello/zephyr/soc/infineon/cat3/Kconfig"
osource "/home/lpp/challenge/challenge-zephyr-hello/zephyr/soc/infineon/cat1b/Kconfig"
osource "/home/lpp/challenge/challenge-zephyr-hello/zephyr/soc/infineon/cat1a/Kconfig"
osource "/home/lpp/challenge/challenge-zephyr-hello/zephyr/soc/gd/gd32/Kconfig"
osource "/home/lpp/challenge/challenge-zephyr-hello/zephyr/soc/gaisler/leon3/Kconfig"
osource "/home/lpp/challenge/challenge-zephyr-hello/zephyr/soc/gaisler/gr716a/Kconfig"
osource "/home/lpp/challenge/challenge-zephyr-hello/zephyr/soc/espressif/Kconfig"
osource "/home/lpp/challenge/challenge-zephyr-hello/zephyr/soc/ene/kb1200/Kconfig"
osource "/home/lpp/challenge/challenge-zephyr-hello/zephyr/soc/efinix/sapphire/Kconfig"
osource "/home/lpp/challenge/challenge-zephyr-hello/zephyr/soc/cdns/xtensa_sample_controller/Kconfig"
osource "/home/lpp/challenge/challenge-zephyr-hello/zephyr/soc/cdns/sample_controller32/Kconfig"
osource "/home/lpp/challenge/challenge-zephyr-hello/zephyr/soc/cdns/dc233c/Kconfig"
osource "/home/lpp/challenge/challenge-zephyr-hello/zephyr/soc/brcm/bcmvk/Kconfig"
osource "/home/lpp/challenge/challenge-zephyr-hello/zephyr/soc/brcm/bcm2712/Kconfig"
osource "/home/lpp/challenge/challenge-zephyr-hello/zephyr/soc/brcm/bcm2711/Kconfig"
osource "/home/lpp/challenge/challenge-zephyr-hello/zephyr/soc/atmel/sam0/Kconfig"
osource "/home/lpp/challenge/challenge-zephyr-hello/zephyr/soc/atmel/sam/Kconfig"
osource "/home/lpp/challenge/challenge-zephyr-hello/zephyr/soc/aspeed/Kconfig"
osource "/home/lpp/challenge/challenge-zephyr-hello/zephyr/soc/arm/Kconfig"
osource "/home/lpp/challenge/challenge-zephyr-hello/zephyr/soc/arm/beetle/Kconfig"
osource "/home/lpp/challenge/challenge-zephyr-hello/zephyr/soc/antmicro/myra/Kconfig"
osource "/home/lpp/challenge/challenge-zephyr-hello/zephyr/soc/andestech/Kconfig"
osource "/home/lpp/challenge/challenge-zephyr-hello/zephyr/soc/amd/acp_6_0/Kconfig"
osource "/home/lpp/challenge/challenge-zephyr-hello/zephyr/soc/ambiq/Kconfig"
osource "/home/lpp/challenge/challenge-zephyr-hello/zephyr/soc/altr/zephyr_nios2f/Kconfig"
osource "/home/lpp/challenge/challenge-zephyr-hello/zephyr/soc/altr/qemu_nios2/Kconfig"
osource "/home/lpp/challenge/challenge-zephyr-hello/zephyr/soc/adi/max32/Kconfig"
```
